
#include <behaviors.dtsi>
#include <dt-bindings/zmk/keys.h>

#include "../../../config/keymap.keymap"


#include <input/processors.dtsi>

&mkp_input_listener {
    input-processors = <&zip_temp_layer 4 250>;
};
