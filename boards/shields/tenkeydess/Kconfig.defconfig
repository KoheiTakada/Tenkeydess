## boards/shields/tenkeydess/Kconfig.defconfig
```kconfig
if SHIELD_TENKEYDESS_RIGHT

config ZMK_KEYBOARD_NAME
    default "tenkeydess"

endif

if SHIELD_TENKEYDESS_LEFT || SHIELD_TENKEYDESS_RIGHT

config ZMK_SPLIT
    default y

endif
```

## boards/shields/tenkeydess/Kconfig.shield
```kconfig
config SHIELD_TENKEYDESS_LEFT
    def_bool $(shields_list_contains,tenkeydess_left)
config SHIELD_TENKEYDESS_RIGHT
    def_bool $(shields_list_contains,tenkeydess_right)
```
